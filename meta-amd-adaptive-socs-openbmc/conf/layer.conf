## meta-amd-adaptive-socs-openbmc/conf/layer.conf
```bitbake
# We have a conf and classes directory, add to BBPATH
BBPATH .= ":${LAYERDIR}"

# We have recipes-* directories, add to BBFILES
BBFILES += "${LAYERDIR}/recipes-*/*/*.bb \
            ${LAYERDIR}/recipes-*/*/*.bbappend"

BBFILE_COLLECTIONS += "amd-adaptive-socs-openbmc"
BBFILE_PATTERN_amd-adaptive-socs-openbmc = "^${LAYERDIR}/"
BBFILE_PRIORITY_amd-adaptive-socs-openbmc = "6"

LAYERSUMMARY_amd-adaptive-socs-openbmc = "AMD adaptive SoC OpenBMC configurations"
LAYERDESCRIPTION_amd-adaptive-socs-openbmc = "Board support package layer \
providing machine .conf, machine YAML, and device-tree assets for AMD \
Zynq UltraScale+ MPSoC and SOM OpenBMC devices"

LAYERDEPENDS_amd-adaptive-socs-openbmc = "\
    core \
    phosphor-layer \
    meta-arm \
    arm-toolchain \
    xilinx \
    xilinx-standalone \
    xilinx-standalone-sdt \
    xilinx-microblaze \
    "

LAYERSERIES_COMPAT_amd-adaptive-socs-openbmc = "wrynose"
```
